#include "Driver_SPD2010.h"
#include "../../bus/Bus_ESP32QSPI.h"
#include <Arduino.h>

#if SEEED_GFX_HAS_ESP32S3_LCD
#include "esp_heap_caps.h"
#endif

namespace {
// Exact default vendor command stream from Espressif's Apache-2.0
// esp_lcd_spd2010 1.0.1, the version selected by the Watcher BSP.
// Encoding is [command, parameter-count, parameters].
static const uint8_t kSpd2010Init[] = {
0xFF,0x03,0x20,0x10,0x10,0x0C,0x01,0x11,0x10,0x01,0x02,0x11,0x01,0x11,0x15,0x01,0x42,0x16,0x01,0x11,0x1A,0x01,0x02,0x1B,0x01,0x11,0x61,0x01,0x80,0x62,0x01,0x80,
0x54,0x01,0x44,0x58,0x01,0x88,0x5C,0x01,0xCC,0xFF,0x03,0x20,0x10,0x10,0x20,0x01,0x80,0x21,0x01,0x81,0x22,0x01,0x31,0x23,0x01,0x20,0x24,0x01,0x11,0x25,0x01,0x11,
0x26,0x01,0x12,0x27,0x01,0x12,0x30,0x01,0x80,0x31,0x01,0x81,0x32,0x01,0x31,0x33,0x01,0x20,0x34,0x01,0x11,0x35,0x01,0x11,0x36,0x01,0x12,0x37,0x01,0x12,0xFF,0x03,
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0x2D,0x02,0x01,0x00,0xFF,0x03,0x20,0x10,0x00,0x11,0x00
};
}

Driver_SPD2010::Driver_SPD2010(uint16_t width, uint16_t height)
    : _width(width), _height(height), _qspi(nullptr), _frameBuffer(nullptr),
      _transferBuffer(nullptr), _transferCapacityPixels(0),
      _windowX0(0), _windowY0(0), _windowX1(width - 1),
      _windowY1(height - 1), _cursorX(0), _cursorY(0), _sleeping(false) {
    IDriver::_width = width;
    IDriver::_height = height;
}

Driver_SPD2010::~Driver_SPD2010() {
    if (_qspi) (void)_qspi->waitForTransfer();
#if SEEED_GFX_HAS_ESP32S3_LCD
    if (_frameBuffer) heap_caps_free(_frameBuffer);
    if (_transferBuffer) heap_caps_free(_transferBuffer);
#endif
}

bool Driver_SPD2010::runInitSequence() {
    // Match esp_lcd_spd2010's lifecycle: reset first, then explicitly select
    // the user command page and configure rotation/color depth before the
    // vendor-specific table. The vendor table does not replace MADCTL or
    // COLMOD; omitting COLMOD leaves RGB565 transfers undefined.
    if (!_qspi->writeCommandData(0x01, nullptr, 0)) return false;
    delay(120);

    const uint8_t userPage[3] = {0x20, 0x10, 0x00};
    if (!_qspi->writeCommandData(0xFF, userPage, sizeof(userPage))) return false;
    const uint8_t madctl = 0x00;
    if (!_qspi->writeCommandData(0x36, &madctl, 1)) return false;
    const uint8_t colmod = 0x55;
    if (!_qspi->writeCommandData(0x3A, &colmod, 1)) return false;

    size_t offset = 0;
    while (offset < sizeof(kSpd2010Init)) {
        const uint8_t cmd = kSpd2010Init[offset++];
        const uint8_t len = kSpd2010Init[offset++];
        if (offset + len > sizeof(kSpd2010Init)) return false;
        if (!_qspi->writeCommandData(cmd, kSpd2010Init + offset, len)) {
            return false;
        }
        offset += len;
        if (cmd == 0x11 && len == 0) delay(120);
    }
    return _qspi->writeCommandData(0x29, nullptr, 0);
}

bool Driver_SPD2010::init(IBus& bus) {
    _bus = &bus;
    // ProductCatalog constructs this driver only with Bus_ESP32QSPI. Avoid
    // RTTI because the ESP32 Arduino core is built with -fno-rtti.
    _qspi = static_cast<Bus_ESP32QSPI*>(&bus);
#if SEEED_GFX_HAS_ESP32S3_LCD
    const size_t framePixels =
        static_cast<size_t>(_width) * static_cast<size_t>(_height);
    _frameBuffer = static_cast<uint16_t*>(
        heap_caps_calloc(framePixels, sizeof(uint16_t),
                         MALLOC_CAP_SPIRAM | MALLOC_CAP_8BIT));
    // A horizontal logical run is either one native row, or after a 90-degree
    // rotation a four-pixel-wide aligned column spanning up to nativeHeight().
    _transferCapacityPixels =
        static_cast<size_t>(_width) >
                static_cast<size_t>(_height) * 4U
            ? static_cast<size_t>(_width)
            : static_cast<size_t>(_height) * 4U;
    _transferBuffer = static_cast<uint16_t*>(
        heap_caps_malloc(_transferCapacityPixels * sizeof(uint16_t),
                         MALLOC_CAP_DMA | MALLOC_CAP_INTERNAL));
    if (!_frameBuffer || !_transferBuffer) {
        if (_frameBuffer) {
            heap_caps_free(_frameBuffer);
            _frameBuffer = nullptr;
        }
        if (_transferBuffer) {
            heap_caps_free(_transferBuffer);
            _transferBuffer = nullptr;
        }
        _transferCapacityPixels = 0;
        return false;
    }
#else
    return false;
#endif
    if (!runInitSequence()) {
        setOperationError(DriverOperationError::CommunicationFailed);
        return false;
    }
    setAddrWindow(0, 0, width() - 1, height() - 1);
    return true;
}

void Driver_SPD2010::setRotation(uint8_t rotation) {
    _rotation = rotation & 3U;
    // SPD2010 has no controller-side XY swap. storeAndFlush() maps each
    // logical scan-line segment into the native shadow framebuffer instead.
    setAddrWindow(0, 0, width() - 1, height() - 1);
}

void Driver_SPD2010::invertDisplay(bool invert) {
    if (_qspi) (void)_qspi->writeCommandData(invert ? 0x21 : 0x20, nullptr, 0);
}

void Driver_SPD2010::displayOn() {
    if (_qspi) {
        (void)_qspi->writeCommandData(0x11, nullptr, 0);
        delay(120);
        (void)_qspi->writeCommandData(0x29, nullptr, 0);
    }
    _sleeping = false;
}

void Driver_SPD2010::displayOff() {
    if (_qspi) (void)_qspi->writeCommandData(0x28, nullptr, 0);
}

void Driver_SPD2010::sleep() {
    if (_qspi) {
        (void)_qspi->waitForTransfer();
        (void)_qspi->writeCommandData(0x10, nullptr, 0);
        delay(120);
    }
    _sleeping = true;
}

void Driver_SPD2010::wake() {
    if (_sleeping) displayOn();
}

void Driver_SPD2010::setAddrWindow(uint16_t xs, uint16_t ys,
                                   uint16_t xe, uint16_t ye) {
    _windowX0 = xs < _width ? xs : static_cast<uint16_t>(_width - 1);
    _windowY0 = ys < _height ? ys : static_cast<uint16_t>(_height - 1);
    _windowX1 = xe < _width ? xe : static_cast<uint16_t>(_width - 1);
    _windowY1 = ye < _height ? ye : static_cast<uint16_t>(_height - 1);
    if (_windowX1 < _windowX0) _windowX1 = _windowX0;
    if (_windowY1 < _windowY0) _windowY1 = _windowY0;
    _cursorX = _windowX0;
    _cursorY = _windowY0;
}

uint16_t Driver_SPD2010::contiguousCount(size_t remaining) const {
    const uint16_t rowRemaining =
        static_cast<uint16_t>(_windowX1 - _cursorX + 1U);
    return remaining < rowRemaining ? static_cast<uint16_t>(remaining)
                                    : rowRemaining;
}

bool Driver_SPD2010::sendWindow(uint16_t x0, uint16_t y0,
                                uint16_t x1, uint16_t y1) {
    const uint8_t columns[4] = {
        static_cast<uint8_t>(x0 >> 8), static_cast<uint8_t>(x0),
        static_cast<uint8_t>(x1 >> 8), static_cast<uint8_t>(x1)
    };
    const uint8_t rows[4] = {
        static_cast<uint8_t>(y0 >> 8), static_cast<uint8_t>(y0),
        static_cast<uint8_t>(y1 >> 8), static_cast<uint8_t>(y1)
    };
    return _qspi->writeCommandData(0x2A, columns, sizeof(columns)) &&
           _qspi->writeCommandData(0x2B, rows, sizeof(rows));
}

void Driver_SPD2010::logicalToNative(uint16_t x, uint16_t y,
                                     uint16_t& nativeX,
                                     uint16_t& nativeY) const {
    switch (_rotation) {
        case 0:
            nativeX = x;
            nativeY = y;
            break;
        case 1:
            nativeX = static_cast<uint16_t>(_width - 1U - y);
            nativeY = x;
            break;
        case 2:
            nativeX = static_cast<uint16_t>(_width - 1U - x);
            nativeY = static_cast<uint16_t>(_height - 1U - y);
            break;
        default:
            nativeX = y;
            nativeY = static_cast<uint16_t>(_height - 1U - x);
            break;
    }
}

bool Driver_SPD2010::flushNativeRect(uint16_t x0, uint16_t y0,
                                     uint16_t x1, uint16_t y1) {
    // SPD2010 requires the start and exclusive end X coordinates to be
    // divisible by four. Keep a native shadow framebuffer so the extra
    // alignment pixels come from the existing image instead of corrupting
    // adjacent content.
    const uint16_t alignedX0 = static_cast<uint16_t>(x0 & ~3U);
    uint16_t alignedXEnd = static_cast<uint16_t>((x1 + 4U) & ~3U);
    if (alignedXEnd > _width) alignedXEnd = _width;
    const uint16_t alignedWidth =
        static_cast<uint16_t>(alignedXEnd - alignedX0);
    const uint16_t rectHeight = static_cast<uint16_t>(y1 - y0 + 1U);
    const size_t pixelCount =
        static_cast<size_t>(alignedWidth) * rectHeight;
    if (alignedWidth == 0 || pixelCount > _transferCapacityPixels ||
        !_qspi->acquireTransferBuffer()) {
        return false;
    }

    size_t output = 0;
    for (uint16_t row = y0; row <= y1; ++row) {
        const size_t source =
            static_cast<size_t>(row) * _width + alignedX0;
        for (uint16_t column = 0; column < alignedWidth; ++column) {
            const uint16_t color = _frameBuffer[source + column];
            _transferBuffer[output++] =
                static_cast<uint16_t>((color << 8) | (color >> 8));
        }
    }

    if (!sendWindow(alignedX0, y0,
                    static_cast<uint16_t>(alignedXEnd - 1U), y1) ||
        !_qspi->writeColor(0x2C, _transferBuffer,
                           pixelCount * sizeof(uint16_t))) {
        _qspi->releaseTransferBuffer();
        return false;
    }
    return true;
}

bool Driver_SPD2010::storeAndFlush(const uint16_t* data, uint16_t count,
                                   bool fill, uint16_t fillColor) {
    if (!_frameBuffer || count == 0) return false;

    uint16_t minX = _width;
    uint16_t minY = _height;
    uint16_t maxX = 0;
    uint16_t maxY = 0;
    for (uint16_t i = 0; i < count; ++i) {
        uint16_t nativeX = 0;
        uint16_t nativeY = 0;
        logicalToNative(static_cast<uint16_t>(_cursorX + i), _cursorY,
                        nativeX, nativeY);
        _frameBuffer[static_cast<size_t>(nativeY) * _width + nativeX] =
            fill ? fillColor : data[i];
        if (nativeX < minX) minX = nativeX;
        if (nativeX > maxX) maxX = nativeX;
        if (nativeY < minY) minY = nativeY;
        if (nativeY > maxY) maxY = nativeY;
    }
    return flushNativeRect(minX, minY, maxX, maxY);
}

void Driver_SPD2010::advance(uint16_t count) {
    while (count--) {
        if (_cursorX < _windowX1) ++_cursorX;
        else {
            _cursorX = _windowX0;
            if (_cursorY < _windowY1) ++_cursorY;
            else _cursorY = _windowY0;
        }
    }
}

void Driver_SPD2010::writePixel(uint16_t color) {
    writePixels(&color, 1);
}

void Driver_SPD2010::writePixels(const uint16_t* data, size_t len) {
    if (!_qspi || !_frameBuffer || !_transferBuffer || !data) return;
    while (len) {
        const uint16_t count = contiguousCount(len);
        if (!storeAndFlush(data, count, false, 0)) {
            setOperationError(DriverOperationError::CommunicationFailed);
            return;
        }
        data += count;
        len -= count;
        advance(count);
    }
}

void Driver_SPD2010::writeFill(uint16_t color, size_t len) {
    if (!_qspi || !_frameBuffer || !_transferBuffer) return;
    while (len) {
        const uint16_t count = contiguousCount(len);
        if (!storeAndFlush(nullptr, count, true, color)) {
            setOperationError(DriverOperationError::CommunicationFailed);
            return;
        }
        len -= count;
        advance(count);
    }
}
